## config/west.yml
```yaml
manifest:
  remotes:
    - name: zmkfirmware
      url-base: https://github.com/zmkfirmware
    - name: willACosta
      url-base: https://github.com/WillACosta

  projects:
    - name: zmk
      remote: zmkfirmware
      revision: main
      import: app/west.yml

    - name: prospector-zmk-module
      remote: willACosta
      revision: main
      path: modules/prospector-zmk-module

  self:
    path: config
```
